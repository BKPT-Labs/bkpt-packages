## viewalyzer-recorder/recorder/zephyr/Kconfig
```kconfig
# Copyright 2025-2026 BKPT, Inc.
# SPDX-License-Identifier: Apache-2.0

menuconfig VIEWALYZER
	bool "ViewAlyzer Trace Recorder"
	default n
	depends on CPU_CORTEX_M
	select TRACING
	help
	  Enable the ViewAlyzer binary trace recorder for Zephyr.

	  Available on Arm Cortex-M only: timestamps come from the DWT cycle
	  counter and the transports use ITM/RTT/probe memory reads.

	  Every event category below is independent: turning one off compiles
	  out its events, its packet builders, its registry storage, and its
	  kernel trace points, so you only pay for what you record. The set you
	  chose is reported to the host with every setup bundle, so the viewer
	  can say "disabled in this firmware build" instead of showing an empty
	  view.

if VIEWALYZER

# Hidden: true when ANY enabled category needs thread ids and names, even if
# thread switch EVENTS are off. Mutex contention, sleep, and stack usage all
# name threads, so registration (and the kernel support it needs) has to
# survive independently of CONFIG_VIEWALYZER_TRACE_THREADS.
config VIEWALYZER_NEEDS_THREAD_REGISTRY
	bool
	default y if VIEWALYZER_TRACE_THREADS || VIEWALYZER_STACK_USAGE || \
		     VIEWALYZER_TRACE_MUTEX_CONTENTION || VIEWALYZER_TRACE_SLEEP
	select TRACING_THREAD
	select THREAD_MONITOR
	select THREAD_NAME

choice VIEWALYZER_TRANSPORT
	prompt "Transport backend"
	default VIEWALYZER_TRANSPORT_ITM
	help
	  Select how the recorder sends trace data to the host.

config VIEWALYZER_TRANSPORT_ITM
	bool "ARM ITM / SWO"
	help
	  Send recorder data over the Cortex-M ITM stimulus port.

config VIEWALYZER_TRANSPORT_RTT
	bool "SEGGER RTT"
	select HAS_SEGGER_RTT
	select USE_SEGGER_RTT
	select STM32_ENABLE_DEBUG_SLEEP_STOP if SOC_FAMILY_STM32
	help
	  Send recorder data over SEGGER RTT.  Requires the Zephyr Segger module
	  (add 'segger' to the west manifest name-allowlist then run west update).

config VIEWALYZER_TRANSPORT_RAMBUF
	bool "ViewAlyzer RAM buffer"
	select STM32_ENABLE_DEBUG_SLEEP_STOP if SOC_FAMILY_STM32
	help
	  Buffer recorder data in a ring buffer in target RAM that the host
	  drains through the debug probe with non-intrusive memory reads:
	  RTT-style streaming that works with ST-LINK and any other probe,
	  with no SEGGER code or Zephyr Segger module required.  The host
	  finds the control block by scanning RAM for its magic tag, or
	  directly via the _VA_RAMBUF ELF symbol.

endchoice

config VIEWALYZER_TRACE_THREADS
	bool "Trace thread switches"
	default y
	help
	  Emit thread switch-in/switch-out and thread-create events. Thread
	  ids and names are still registered when this is off but another
	  category (stack usage, mutex contention, sleep) needs them.

config VIEWALYZER_TRACE_ISRS
	bool "Trace ISRs"
	default y
	select TRACING_ISR

config VIEWALYZER_TRACE_MUTEXES
	bool "Trace mutexes"
	default y
	select TRACING_MUTEX

config VIEWALYZER_TRACE_MUTEX_CONTENTION
	bool "Trace mutex contention (who is blocked on whom)"
	default y
	select TRACING_MUTEX
	help
	  Emit a contention event when a thread blocks on a mutex another
	  thread holds, naming both threads. Works with mutex give/take
	  tracing turned off: the mutex and both threads are still registered
	  so the contention event can name them, but no mutex give/take
	  events reach the wire.

config VIEWALYZER_TRACE_SEMAPHORES
	bool "Trace semaphores"
	default y
	select TRACING_SEMAPHORE

config VIEWALYZER_TRACE_EVENT_FLAGS
	bool "Trace event flags (k_event)"
	default y
	select TRACING_EVENT
	help
	  Emit set/wait events (with the bits involved) for k_event objects,
	  and a failed-op event when a wait times out.  Allows the viewer to
	  display event-flag traffic alongside queues and semaphores.

config VIEWALYZER_TRACE_WORK
	bool "Trace deferred work (k_work / k_work_delayable)"
	default y
	select TRACING_WORK
	help
	  Emit an event when work is submitted, scheduled, rescheduled, or
	  canceled, carrying the handler address (symbolicated by the viewer
	  from the ELF) and the schedule delay.  The kernel has no trace point
	  around handler execution, so execution time is attributed to the
	  workqueue thread.

config VIEWALYZER_TRACE_SLEEP
	bool "Trace thread sleep (k_sleep / k_msleep / k_usleep)"
	default y
	help
	  Emit enter/exit events when threads call k_sleep, k_msleep,
	  or k_usleep.  Allows the viewer to distinguish explicit sleep
	  from generic OS/idle time.

config VIEWALYZER_TRACE_TIMERS
	bool "Trace kernel timers (k_timer)"
	default y
	select TRACING_TIMER
	help
	  Emit init/start/stop events when threads create, arm, or cancel
	  kernel timers.  Allows the viewer to display timer lifecycle on
	  the event table and timeline.

config VIEWALYZER_TRACE_HEAPS
	bool "Trace kernel heaps (k_heap alloc/free)"
	default y
	select TRACING_HEAP
	help
	  Emit alloc/free events for kernel heaps.  Allows the viewer to
	  display allocation patterns, sizes, and potential memory leaks.

config VIEWALYZER_TRACE_PM
	bool "Trace power management suspend/resume"
	default y
	depends on PM
	select TRACING_PM
	help
	  Emit enter/exit events when the system enters or exits a low-power
	  state via pm_system_suspend.  Requires CONFIG_PM to be enabled.
	  Allows the viewer to display low-power periods in the event table
	  and timeline.

config VIEWALYZER_HEAP_RUNTIME_STATS
	bool "Send heap runtime statistics (allocated_bytes) in heap events"
	default y
	depends on VIEWALYZER_TRACE_HEAPS
	select SYS_HEAP_RUNTIME_STATS
	help
	  When enabled, each heap alloc/free trace event carries the current
	  total allocated_bytes from the Zephyr sys_heap runtime statistics
	  instead of just the individual request size.  This lets ViewAlyzer
	  show live heap usage, high-water marks, and inferred free sizes.
	  Adds a small overhead per alloc/free to query heap stats.

config VIEWALYZER_TRACE_MESSAGE_QUEUES
	bool "Trace message queues"
	default y
	select TRACING_MESSAGE_QUEUE

config VIEWALYZER_TRACE_USER_VALUES
	bool "Trace user values (VA_LogTrace / VA_LogTraceFloat / VA_LogToggle)"
	default y
	help
	  Your own named values plotted against the timeline. Independent of
	  the kernel - this works on bare metal too.

config VIEWALYZER_TRACE_USER_EVENTS
	bool "Trace user event spans (VA_EVENT_START / VA_EVENT_END)"
	default y

config VIEWALYZER_TRACE_STRINGS
	bool "Trace log strings (VA_LogString)"
	default y

config VIEWALYZER_TRACE_GPIO
	bool "Trace GPIO state (VA_LogGPIO)"
	default y

config VIEWALYZER_TRACE_COUNTERS
	bool "Trace counters (VA_LogCounter)"
	default y

config VIEWALYZER_TRACE_HEAP_METRICS
	bool "Trace the manual heap gauge (VA_LogHeap)"
	default y
	help
	  Your own heap-usage readings, reported by calling VA_LogHeap. This
	  is separate from VIEWALYZER_TRACE_HEAPS, which traces the Zephyr
	  k_heap allocator automatically.

config VIEWALYZER_STACK_USAGE
	bool "Capture thread stack usage"
	default y
	select INIT_STACKS
	select THREAD_STACK_INFO

config VIEWALYZER_STACK_USAGE_HEARTBEAT_MS
	int "Stack-usage heartbeat interval (ms)"
	default 500
	help
	  Stack usage is sampled and emitted on thread switch-out, at most once
	  per this many milliseconds per thread. The high-water scan runs with
	  interrupts masked, so this interval also bounds its cost per context
	  switch. 0 = sample on every switch-out (much higher overhead and
	  bandwidth).

config VIEWALYZER_BUFFERED
	bool "Buffer trace packets in RAM and drain them explicitly"
	default n
	help
	  When enabled, trace hooks copy packets into a RAM ring buffer (bounded,
	  non-blocking) instead of writing straight to the wire, and VA_Drain()
	  (call from your idle thread / main loop) flushes the ring. This bounds
	  per-hook latency regardless of wire backpressure, at the cost of the
	  on-wire byte position lagging the event - so it is INCOMPATIBLE with
	  fused ETM+ITM time-correlation captures. Leave off for the default
	  direct-to-wire behaviour.

config VIEWALYZER_BUFFER_SIZE
	int "Trace ring buffer size (bytes)"
	default 4096
	depends on VIEWALYZER_BUFFERED
	help
	  Capacity of the RAM ring buffer used in buffered mode. Larger buffers
	  absorb bigger bursts before dropping packets.

config VIEWALYZER_MAX_SYNC_OBJECTS
	int "Max sync object slots"
	default 64
	help
	  Number of mutex, semaphore, and queue objects the recorder can track.

config VIEWALYZER_MAX_TASKS
	int "Max task slots"
	default 16
	help
	  Number of RTOS task or thread entries the recorder can track.

config VIEWALYZER_MAX_USER_EVENTS
	int "Max user trace / event slots"
	default 16
	help
	  Number of user trace and user event IDs the recorder can store.

config VIEWALYZER_MAX_GPIOS
	int "Max GPIO channel slots"
	default 16
	help
	  Number of VA_RegisterGPIO() channels the recorder can store for
	  periodic name re-emission.

config VIEWALYZER_MAX_HEAP_GAUGES
	int "Max manual heap gauge slots"
	default 8
	help
	  Number of VA_RegisterHeap() gauges the recorder can store for
	  periodic name re-emission.

config VIEWALYZER_MAX_TASK_NAME_LEN
	int "Max task name length"
	default 16
	range 4 255
	help
	  Maximum stored length for task, object, and user-function names.

config VIEWALYZER_ALLOW_DISABLE_INTERRUPTS
	bool "Allow interrupt masking in recorder critical sections"
	default y
	help
	  Allow the recorder to mask interrupts around short internal critical
	  sections. Disable this if the target environment must never disable
	  interrupts from inside the recorder.

config VIEWALYZER_RTT_CHANNEL
	int "RTT up-buffer channel"
	default 0
	range 0 15
	depends on VIEWALYZER_TRANSPORT_RTT
	help
	  SEGGER RTT up-buffer channel used by the recorder.

config VIEWALYZER_CONFIGURE_RTT
	bool "Configure the RTT up-buffer in VA_Init()"
	default y
	depends on VIEWALYZER_TRANSPORT_RTT
	help
	  Let the recorder call SEGGER_RTT_Init() and configure its RTT
	  up-buffer during initialization. Disable this if another component
	  owns RTT channel setup.

config VIEWALYZER_RTT_BUFFER_SIZE
	int "Recorder RTT buffer size"
	default 4096
	range 0 65535
	depends on VIEWALYZER_TRANSPORT_RTT && VIEWALYZER_CONFIGURE_RTT
	help
	  Size of the recorder-owned RTT up-buffer. Set to 0 to use the RTT
	  control block without providing a dedicated buffer.

config VIEWALYZER_RAMBUF_SIZE
	int "RAM buffer size (bytes)"
	default 8192
	range 256 1048576
	depends on VIEWALYZER_TRANSPORT_RAMBUF
	help
	  Bytes of target RAM reserved for the trace ring buffer.  Larger
	  buffers absorb bigger event bursts between host drain polls before
	  packets are dropped (or, in blocking mode, before hooks stall).

config VIEWALYZER_RAMBUF_BLOCK
	bool "Block when the RAM buffer is full (lossless)"
	default n
	depends on VIEWALYZER_TRANSPORT_RAMBUF
	depends on !VIEWALYZER_RAMBUF_WRAP
	help
	  When the ring buffer is full, wait for the host to drain it instead
	  of dropping whole packets.  Lossless, but stalls the firmware if no
	  host is attached and draining - leave disabled unless you need
	  guaranteed capture of every event.

config VIEWALYZER_RAMBUF_WRAP
	bool "Post-mortem snapshot mode (overwrite oldest, no live streaming)"
	default n
	depends on VIEWALYZER_TRANSPORT_RAMBUF
	help
	  Turn the RAM buffer into a post-mortem snapshot ring: when full, the
	  oldest packets are overwritten so the ring always holds the most
	  recent trace window.  Run untethered, then read the window out after
	  a crash or hang with "ViewAlyzer --headless --snapshot" (or the GUI
	  Take Snapshot button).  Live streaming is not possible in this mode;
	  use the default drop mode (or VIEWALYZER_SNAPSHOT alongside another
	  transport) if you need to stream while the system runs.  From a
	  fault handler, call VA_SnapshotFreeze() to preserve the window.

config VIEWALYZER_SNAPSHOT
	bool "Post-mortem snapshot ring alongside the live transport"
	default n
	depends on !VIEWALYZER_RAMBUF_WRAP
	help
	  Tee every trace packet into a second, wrapping RAM ring that always
	  holds the most recent window, while the selected transport streams
	  live as usual.  After a crash or hang, read the window out through
	  the debug probe with "ViewAlyzer --headless --snapshot" - no host
	  connection is needed while the system runs.  Costs
	  VIEWALYZER_SNAPSHOT_SIZE bytes of RAM plus one byte per packet.
	  From a fault handler, call VA_SnapshotFreeze() to preserve the
	  window.

config VIEWALYZER_SNAPSHOT_SIZE
	int "Snapshot ring size (bytes)"
	default 4096
	range 256 1048576
	depends on VIEWALYZER_SNAPSHOT
	help
	  Bytes of target RAM reserved for the post-mortem snapshot ring.
	  Bigger rings hold a longer window before the oldest packets are
	  overwritten.

config VIEWALYZER_SNAPSHOT_SETUP_SIZE
	int "Snapshot names area size (bytes)"
	default 1024
	range 0 65536
	depends on VIEWALYZER_RAMBUF_WRAP || VIEWALYZER_SNAPSHOT
	help
	  RAM beside the snapshot ring that always holds the latest setup
	  bundle (thread, ISR, trace and sync-object names) so a snapshot
	  window shorter than the bundle interval still gets full names.
	  Size it to hold your registries (roughly 20 bytes per named
	  entity); if the bundle outgrows it, the names that no longer fit
	  are dropped. 0 disables the area (snapshots then show generic
	  "Task N" style names unless the window happens to contain a
	  bundle).

config VIEWALYZER_RAMBUF_BUSY_IDLE
	bool "Keep the CPU awake so probe reads stay valid (busy idle)"
	default y
	depends on VIEWALYZER_TRANSPORT_RAMBUF
	help
	  Spin in the idle hook instead of letting the idle thread reach WFI.
	  On some probe/MCU combinations (verified: ST-LINK V3 + STM32G4)
	  debug memory reads return a stuck garbage word while the core
	  sleeps - even with the DBGMCU sleep-debug bits set - which corrupts
	  the drained trace stream.  Interrupts stay enabled while spinning,
	  so scheduling and timeouts are unaffected; the cost is idle-mode
	  power.  Disable only after verifying clean captures on your target
	  while it sleeps, or when power draw matters more than streaming.

	  CAUTION: with CONFIG_PM=y the kernel can suspend through the PM
	  subsystem instead of the idle hook this option uses, and the core
	  then sleeps anyway.  When streaming over the RAM buffer transport,
	  keep PM sleep states disabled (or verify clean captures with your
	  PM policy active).

config VIEWALYZER_AUTO_SETUP_INTERVAL_MS
	int "Auto setup bundle re-emit interval (ms)"
	default 2000
	range 0 60000
	help
	  Interval in milliseconds at which the recorder automatically
	  re-emits the sync marker and setup packets. This helps the host
	  application resync if it connects mid-session. Set to 0 to disable
	  automatic re-emission.

endif
```
